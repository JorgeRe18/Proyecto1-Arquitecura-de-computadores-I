## parte_yocto/meta-proyectouno/conf/layer.conf
```bitbake
# We have a conf and classes directory, add to BBPATH
BBPATH.=":${LAYERDIR}"

# We have recipes-* directories, add to BBFILES
BBFILES += "${LAYERDIR}/recipes-*/*.bb \
            ${LAYERDIR}/recipes-*/*/*.bbappend"

BBFILE_COLLECTIONS +="proyectouno"
BBFILE_PATTERN_proyectouno ="^${LAYERDIR}/"
BBFILE_PRIORITY_proyectouno ="5"
LAYERVERSION_proyectouno ="4"
LAYERSERIES_COMPAT_proyectouno = "warrior"
```
